## main/Kconfig.projbuild
```kconfig
# put here your custom config value
menu "MPU9250 Configuration"
config MPU9250_SCL
    string "MPU9250 SCL Pin"
    default 5
    help
    MPU9250 SCL Pin, default value is 5
config MPU9250_SDA
    string "MPU9250 SDA Pin"
    default 4
    help
    MPU9250 SDA Pin, default value is 4
endmenu

menu "WiFi Configuration"
config ESP_WIFI_SSID
    string "WiFi SSID"
    default "myssid"
    help
	SSID (network name) for the example to connect to.

config ESP_WIFI_PASSWORD
    string "WiFi Password"
    default "mypassword"
    help
	WiFi password (WPA or WPA2) for the example to use.
endmenu
```
